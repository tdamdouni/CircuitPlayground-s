#include <SPI.h>
#include <Wire.h>
#include <Adafruit_CircuitPlayground.h> 

/*
The Circuit Playground Dice Bag The SpeakNRoll Version  - CC Attribution-ShareAlike 4.0 International Tom Higgins & Sons 

Added code to speak out the results. As the speaker on the CP is tiny it is hard to make out the samples. We are working
on finding clearer and louder samples. 

TO select the type of die you would like to throw 
  First put the Select Switch in the proper position
  Then press the proper Button

Select Switch     Left Button  Right Button
----------------+------------+-------------+
+               | d100 (0-99)| d20 (1-20)  | 
----------------|------------|-------------|
-               |  d12 (1-12)| d06 (1-6)   |
--------------------------------------------

You can hold down the Button and it will flash through many tosses.
Release the Button and your results will show on the Circuit Playground as 
two (or one) lit NeoPixel

Red=Tens Place (0-9)
Blue=Ones Place (0-9)
Green=Tens and Ones are the same (00,11,22,33,44,55,66,77,88,99)

The NeoPixels are arranged from 0 - 9 . If you are holding your Circuit Playground with the USB port facing Up

0 is the top left NeoPixel closest to the USB port
1 is to the left of that
..
4 is the bottom let NeoPixel closest to the Battery Jack
5 is the bottom right NeoPixel closest to the Battery Jack
..
9 is the top tight NeoPixel closest to the USB port


*/

const uint8_t spZERO[]          PROGMEM = {0x69,0xFB,0x59,0xDD,0x51,0xD5,0xD7,0xB5,0x6F,0x0A,0x78,0xC0,0x52,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0xFF,0x1F};
//const uint8_t spONE[]           PROGMEM = {0x66,0x4E,0xA8,0x7A,0x8D,0xED,0xC4,0xB5,0xCD,0x89,0xD4,0xBC,0xA2,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0xFE,0x1F};
//const uint8_t spTWO[]           PROGMEM = {0x06,0xB8,0x59,0x34,0x00,0x27,0xD6,0x38,0x60,0x58,0xD3,0x91,0x55,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0xFF,0x1F};
//const uint8_t spTHREE[]         PROGMEM = {0x0C,0xE8,0x2E,0x94,0x01,0x4D,0xBA,0x4A,0x40,0x03,0x16,0x68,0x69,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0xFF,0x03};
//const uint8_t spFOUR[]          PROGMEM = {0x08,0x68,0x21,0x0D,0x03,0x04,0x28,0xCE,0x92,0x03,0x23,0x4A,0xCA,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0xF2,0xFF};
//const uint8_t spFIVE[]          PROGMEM = {0x08,0x68,0x4E,0x9D,0x02,0x1C,0x60,0xC0,0x8C,0x69,0x12,0xB0,0xC0,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0xFF,0x01};
//const uint8_t spSIX[]           PROGMEM = {0x04,0xF8,0xAD,0x4C,0x02,0x16,0xB0,0x80,0x06,0x56,0x35,0x5D,0xA8,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0xFF,0x01};
//const uint8_t spSEVEN[]         PROGMEM = {0x0C,0xF8,0x5E,0x4C,0x01,0xBF,0x95,0x7B,0xC0,0x02,0x16,0xB0,0xC0,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0xFB,0x7F};
//const uint8_t spEIGHT[]         PROGMEM = {0x65,0x69,0x89,0xC5,0x73,0x66,0xDF,0xE9,0x8C,0x33,0x0E,0x41,0xC6,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0xF8,0x7F};
//const uint8_t spNINE[]          PROGMEM = {0xE6,0xA8,0x1A,0x35,0x5D,0xD6,0x9A,0x35,0x4B,0x8C,0x4E,0x6B,0x1A,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0xFF,0x0F};
//const uint8_t spTEN[]           PROGMEM = {0x0E,0x38,0x3C,0x2D,0x00,0x5F,0xB6,0x19,0x60,0xA8,0x90,0x93,0x36,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0xFF,0x03};
//const uint8_t spELEVEN[]        PROGMEM = {0xA5,0xEF,0xD6,0x50,0x3B,0x67,0x8F,0xB9,0x3B,0x23,0x49,0x7F,0x33,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0xFF,0x0F};
//const uint8_t spTWELVE[]        PROGMEM = {0x09,0x98,0xDA,0x22,0x01,0x37,0x78,0x1A,0x20,0x85,0xD1,0x50,0x3A,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0xFE,0x1F};
//const uint8_t spTWENTY[]        PROGMEM = {0x0A,0xE8,0x4A,0xCD,0x01,0xDB,0xB9,0x33,0xC0,0xA6,0x54,0x0C,0xA4,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0xFF,0x1F};
//const uint8_t spHUNDRED[]       PROGMEM = {0x04,0xC8,0x7E,0x5C,0x02,0x0A,0xA8,0x62,0x43,0x03,0xA7,0xA8,0x62,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0xF9,0x7F};
const uint8_t spONE[]       PROGMEM = {0xCC,0x67,0x75,0x42,0x59,0x5D,0x3A,0x4F,0x9D,0x36,0x63,0xB7,0x59,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0xFF,0x0F};
const uint8_t spTWO[]       PROGMEM = {0x0E,0x38,0x6E,0x25,0x00,0xA3,0x0D,0x3A,0xA0,0x37,0xC5,0xA0,0x05,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0xFF,0x0F};
const uint8_t spTHREE[]     PROGMEM = {0x02,0xD8,0x2E,0x9C,0x01,0xDB,0xA6,0x33,0x60,0xFB,0x30,0x01,0xEC,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0xFF,0x0F};
const uint8_t spFOUR[]      PROGMEM = {0x0C,0x18,0xB6,0x9A,0x01,0xC3,0x75,0x09,0x60,0xD8,0x0E,0x09,0x30,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0xFF,0x07};
const uint8_t spFIVE[]      PROGMEM = {0x02,0xE8,0x3E,0x8C,0x01,0xDD,0x65,0x08,0x60,0x98,0x4C,0x06,0x34,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0xFE,0x7F};
const uint8_t spSIX[]       PROGMEM = {0x0E,0xD8,0xAE,0xDD,0x03,0x0E,0x38,0xA6,0xD2,0x01,0xD3,0xB4,0x2C,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0xFC,0x3F};
const uint8_t spSEVEN[]     PROGMEM = {0x02,0xB8,0x3A,0x8C,0x01,0xDF,0xA4,0x73,0x40,0x01,0x47,0xB9,0x2F,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0xF3,0xFF};
const uint8_t spEIGHT[]     PROGMEM = {0xC3,0x6C,0x86,0xB3,0x27,0x6D,0x0F,0xA7,0x48,0x99,0x4E,0x55,0x3C,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0xFE,0x1F};
const uint8_t spNINE[]      PROGMEM = {0xCC,0xA1,0x26,0xBB,0x83,0x93,0x18,0xCF,0x4A,0xAD,0x2E,0x31,0xED,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0xFF,0x07};
const uint8_t spPAUSE1[]    PROGMEM = {0x00,0x00,0x00,0x00,0xFF,0x0F};





int troll = 0;
int ones = 0;
int tens = 0;


void setup()
{
	Serial.begin(9600);
	randomSeed(analogRead(0));
    CircuitPlayground.begin();
}

void loop()
{
	CircuitPlayground.setBrightness((CircuitPlayground.lightSensor()+4)/4);         //variable neopixel birghtness based on current light level
if (CircuitPlayground.slideSwitch()) {
	if (CircuitPlayground.leftButton()) {tossd100();}
	if (CircuitPlayground.rightButton()) {tossd20();}
      }
else	
	{
	if (CircuitPlayground.leftButton()) {tossd12();}
	if (CircuitPlayground.rightButton()) {tossd06();}
	}
}

void tossd100() {                                         // function for d100
	troll = random(0,99);
    prepthrow(troll);
}

void tossd20() {                                          // function for d20
	troll = random(1,21);
    prepthrow(troll);

}

void tossd12() {                                          // function for d12
	troll = random(1,13);
    prepthrow(troll);
}

void tossd06() {	                                      // function for d6
	troll = random(1,7);
    prepthrow(troll);
}

void prepthrow(int troll) {                               // function to take the roll and parse it to tens and ones
	Serial.println(" ");                                  // print throw results to the console
	Serial.print("Throw was a ");
	Serial.print(troll);
    ones=troll % 10;
    tens=troll / 10;
	showtoss(ones,tens);
   }


void showtoss(int ones,int tens) {                         // function to display the results on the neopixels  
	Serial.print("  tens-");                              // print the tens and ones breakdown to console
	Serial.print(tens);
	Serial.print("  ones-");
	Serial.print(ones);
	CircuitPlayground.clearPixels();
	CircuitPlayground.playTone((ones*100)+1, 50);         // attemped to make it sound like dice being rolled
	CircuitPlayground.speaker.end();
	if (!CircuitPlayground.leftButton() && !CircuitPlayground.rightButton()){
	    speakroll(tens);
	    speakroll(ones);
	}
	if (ones==tens){
	CircuitPlayground.setPixelColor(tens, 5, 255, 5);     // if ones and tens are the same show as green
	
	}
	else {
	CircuitPlayground.setPixelColor(ones, 5, 5, 255);     // show ones as blue    
	CircuitPlayground.setPixelColor(tens, 255, 5, 5); }   // show tens as red
}

void speakroll(int digit) {
	switch (digit) {
    case 0:
	CircuitPlayground.speaker.say(spZERO);
      break;
    case 1:
	CircuitPlayground.speaker.say(spONE);
      break;
    case 2:
	CircuitPlayground.speaker.say(spTWO);
      break;
    case 3:
	CircuitPlayground.speaker.say(spTHREE);
      break;
    case 4:
	CircuitPlayground.speaker.say(spFOUR);
      break;
    case 5:
	CircuitPlayground.speaker.say(spFIVE);
      break;
    case 6:
	CircuitPlayground.speaker.say(spSIX);
      break;
    case 7:
	CircuitPlayground.speaker.say(spSEVEN);
      break;
    case 8:
	CircuitPlayground.speaker.say(spEIGHT);
      break;
    case 9:
	CircuitPlayground.speaker.say(spNINE);
      break;  
	default: 
    CircuitPlayground.speaker.end();
     break;
	}
	CircuitPlayground.speaker.say(spPAUSE1);
	CircuitPlayground.speaker.end();
}
